## sample.yaml
```
sample:
  description: Wi-Fi Fundamentals Course by Nordic Developer Academy (https://academy.nordicsemi.com/)
  name: Wi-Fi Fundamentals Course - Lesson 5 Exercise 3 
  
common: 
    sysbuild: true
    build_only: true
    skip: true
    
tests:
  wifi_fund.l5.e3.nrf5340dk: 
    extra_args: SHIELD=nrf7002ek
    integration_platforms: 
      - nrf5340dk/nrf5340/cpuapp/ns
    platform_allow:
      - nrf5340dk/nrf5340/cpuapp/ns

  
  wifi_fund.l5.e3.nrf7002dk:
    integration_platforms: 
      - nrf7002dk/nrf5340/cpuapp/ns
    platform_allow:
      - nrf7002dk/nrf5340/cpuapp/ns
```

## prj.conf
```kconfig
#
# Copyright (c) 2023 Nordic Semiconductor ASA
#
# SPDX-License-Identifier: LicenseRef-Nordic-5-Clause
#

# Wi-Fi
CONFIG_WIFI=y
CONFIG_WIFI_NM_WPA_SUPPLICANT=y

CONFIG_NRF70_RX_NUM_BUFS=16
CONFIG_NRF70_MAX_TX_AGGREGATION=4

# Wi-Fi credentials
CONFIG_WIFI_CREDENTIALS=y
CONFIG_WIFI_CREDENTIALS_STATIC=n

# Networking Management API
CONFIG_NET_MGMT=y
CONFIG_NET_MGMT_EVENT=y
CONFIG_NET_MGMT_EVENT_INFO=y
CONFIG_NET_CONNECTION_MANAGER=y
CONFIG_NET_CONNECTION_MANAGER_MONITOR_STACK_SIZE=5200
CONFIG_L2_WIFI_CONNECTIVITY=y

# Support for shell commands
CONFIG_SHELL=y
CONFIG_NET_L2_WIFI_SHELL=y
CONFIG_WIFI_CREDENTIALS_SHELL=y
CONFIG_SHELL_STACK_SIZE=6144

# Logging
CONFIG_LOG=y

# DK library
CONFIG_DK_LIBRARY=y


# Networking
CONFIG_NETWORKING=y
CONFIG_NET_SOCKETS=y
CONFIG_NET_L2_ETHERNET=y
CONFIG_NET_IPV4=y
CONFIG_NET_IPV6=n
CONFIG_NET_TCP=y
CONFIG_NET_DHCPV4=y

CONFIG_NET_MAX_CONN=10
CONFIG_NET_MAX_CONTEXTS=20
CONFIG_NET_STATISTICS=y
CONFIG_NET_TCP_TIME_WAIT_DELAY=0

# Memory
CONFIG_SYSTEM_WORKQUEUE_STACK_SIZE=2560
CONFIG_MAIN_STACK_SIZE=6144



# Configure network parameters
CONFIG_NET_BUF_TX_COUNT=72
CONFIG_NET_BUF_RX_COUNT=96
CONFIG_NET_PKT_TX_COUNT=48
CONFIG_NET_PKT_RX_COUNT=64
CONFIG_NET_TCP_WORKQ_STACK_SIZE=2048
CONFIG_NET_CONTEXT_NET_PKT_POOL=y
CONFIG_NET_BUF_POOL_USAGE=y


# DNS
# STEP 1.1 - Enable necssary DNS configurations


# STEP 1.2 - Configure the network library


# HTTP
# STEP 2.1 - Enable the HTTP parser library
```

## boards/nrf5340dk_nrf5340_cpuapp_ns.conf
```kconfig
# UART1 is used for TF-M logging should be disabled
CONFIG_TFM_SECURE_UART=n
CONFIG_TFM_LOG_LEVEL_SILENCE=y

CONFIG_WIFI_CREDENTIALS_BACKEND_PSA=y
CONFIG_TFM_PROFILE_TYPE_SMALL=y
CONFIG_PM_PARTITION_SIZE_TFM_SRAM=0xc000
CONFIG_PM_PARTITION_SIZE_TFM=0x20000
```

## src/main.c
```c
/*
 * Copyright (c) 2019 Intel Corporation
 * Copyright (c) 2023 Nordic Semiconductor ASA
 *
 * SPDX-License-Identifier: Apache-2.0
 */

#include <errno.h>
#include <stddef.h>
#include <string.h>
#include <stdio.h>
#include <zephyr/kernel.h>
#include <zephyr/types.h>
#include <zephyr/logging/log.h>

#include <dk_buttons_and_leds.h>

#include <zephyr/net/net_config.h>
#include <zephyr/net/net_ip.h>
#include <zephyr/net/dns_sd.h>
#include <zephyr/net/net_mgmt.h>
#include <zephyr/net/wifi_mgmt.h>
#include <zephyr/net/wifi_credentials.h>
#include <zephyr/net/socket.h>
#include <zephyr/net/http/client.h>

#include <zephyr/net/conn_mgr_monitor.h>
#include <zephyr/net/conn_mgr_connectivity.h>

/* STEP 2.2 - Include the header file for the HTTP parser library */


LOG_MODULE_REGISTER(Lesson5_Exercise3, LOG_LEVEL_INF);

#define MAX_CLIENT_QUEUE		2
#define STACK_SIZE			    4096
#define THREAD_PRIORITY			K_PRIO_COOP(CONFIG_NUM_COOP_PRIORITIES - 1)
#define EVENT_MASK              (NET_EVENT_L4_CONNECTED | NET_EVENT_L4_DISCONNECTED)

/* STEP 4 - Register service to be advertised via DNS */

/* STEP 5 - Define a struct to represent the structure of HTTP requests */


/* Forward declarations */
static void process_tcp4(void);

/* Keep track of the current LED states. 0 = LED OFF, 1 = LED ON.
 * Index 0 corresponds to LED1, index 1 to LED2.
 */
static uint8_t led_states[2];

/* STEP 6 - Define HTTP server response strings for demonstration */


/* STEP 7 - Set up threads for handling multiple incoming TCP connections simultaneously */


/* STEP 8 - Declare and initialize structs and variables used in network management */


/* STEP 11.1 - Define a variable to store the HTTP parser settings */


static struct net_mgmt_event_callback mgmt_cb;
static bool connected;
static K_SEM_DEFINE(run_app, 0, 1);

static void net_mgmt_event_handler(struct net_mgmt_event_callback *cb,
			  uint64_t mgmt_event, struct net_if *iface)
{
	if ((mgmt_event & EVENT_MASK) != mgmt_event) {
		return;
	}

	if (mgmt_event == NET_EVENT_L4_CONNECTED) {
		LOG_INF("Network connected");
		connected = true;
		k_sem_give(&run_app);

		return;
	}

	if (mgmt_event == NET_EVENT_L4_DISCONNECTED) {
		if (connected == false) {
			LOG_INF("Waiting for network to be connected");
		} else {
			LOG_INF("Network disconnected");
			connected = false;
		}

		k_sem_reset(&run_app);

		return;
	}
}

/* STEP 9 -  Define a function to update the LED state */


/* STEP 10 -   Define a function to handle HTTP requests */


/* STEP 11.2 - Define callbacks for the HTTP parser */


/* STEP 11.3 - Define function to initialize the callbacks */


/* STEP 12 -  Setup the HTTP server */


/* STEP 13 -  Setup the TCP client connection handler */


static int get_free_slot(int *accepted)
{
	int i;

	for (i = 0; i < MAX_CLIENT_QUEUE; i++) {
		if (accepted[i] < 0) {
			return i;
		}
	}

	return -1;
}

/* STEP 14.1 - Define a function to handle incoming TCP connections */


/* STEP 14.2 - Define a function to process incoming IPv4 clients */

/* STEP 15.1 - Define function to start listening on TCP socket */


int main(void)
{
	int err;

	parser_init();

	err = dk_leds_init();
	if (err) {
		LOG_ERR("Failed to initialize LEDs");
		return 0;
	}

	net_mgmt_init_event_callback(&mgmt_cb, net_mgmt_event_handler, EVENT_MASK);
	net_mgmt_add_event_callback(&mgmt_cb);

	conn_mgr_mon_resend_status();

	/* Wait for the connection. */
	k_sem_take(&run_app, K_FOREVER);

	/* STEP 15.2 - Start listening on the TCP socket */


	(void)err;

	return 0;
}
```
