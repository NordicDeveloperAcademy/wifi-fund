## prj.conf
```kconfig
#
# Copyright (c) 2022 Nordic Semiconductor ASA
#
# SPDX-License-Identifier: LicenseRef-Nordic-5-Clause
#

# Wi-Fi
# STEP 1.1 - Enable the Wi-Fi relevant configurations


# STEP 2 - Configure the Wi-Fi credentials
# STEP 12.1 - Diasble static Wi-Fi network configuration


# Networking Management API
# STEP 1.2 Enable the Network Management relevant configurations


# STEP 12.3 Enable support for shell commands


# Logging
CONFIG_LOG=y

# DK library
CONFIG_DK_LIBRARY=y

# System settings
CONFIG_NEWLIB_LIBC=y
CONFIG_NEWLIB_LIBC_NANO=n

# Networking
CONFIG_NETWORKING=y
CONFIG_NET_NATIVE=y
CONFIG_NET_SOCKETS=y
CONFIG_NET_L2_ETHERNET=y
CONFIG_NET_IPV6=n
CONFIG_NET_IPV4=y
CONFIG_NET_DHCPV4=y

# Memory
CONFIG_SYSTEM_WORKQUEUE_STACK_SIZE=4096
CONFIG_MAIN_STACK_SIZE=4096
CONFIG_HEAP_MEM_POOL_SIZE=153600
```

## boards/nrf7002dk_nrf5340_cpuapp.conf
```kconfig
# STEP 13.3 - Create a board-specific file for the secure build target
```

## src/main.c
```c
/*
 * Copyright (c) 2023 Nordic Semiconductor ASA
 *
 * SPDX-License-Identifier: LicenseRef-Nordic-5-Clause
 */

#include <dk_buttons_and_leds.h>

/* STEP 3 - Include the necessary header files */



LOG_MODULE_REGISTER(Lesson2_Exercise2, LOG_LEVEL_INF);

/* STEP 4 - Define a macro for the relevant Wi-Fi events */

/* STEP 12.1 Define a macro for the IPv4 events to watch */


/* STEP 5 - Declare and define the callback structure for Wi-Fi events */

/* STEP 12.2 Declare the callback structure for IPv4 events */


/* STEP 7 - Define the function to populate the Wi-Fi credential parameters */
static int wifi_args_to_params(struct wifi_connect_req_params *params)
{

	/* STEP 7.1 Populate the SSID and password */
	

	/* STEP 7.2 - Populate the rest of the relevant members */
	

	return 0;
}

/* STEP 6 - Define the callback function for Wi-Fi events */

/* STEP 12.3 - Define the callback function for IPv4 events */



int main(void)
{
	/* STEP 8.1 - Declare the variable for the network configuration parameters */
	
	/* STEP 8.2 - Define the variable for the network interface */
	

	if (dk_leds_init() != 0) {
		LOG_ERR("Failed to initialize the LED library");
	}

	/* Sleep to allow initialization of Wi-Fi driver */
	k_sleep(K_SECONDS(1));

	/* STEP 9 - Initialize and add the callback function for Wi-Fi events */
	

	/* STEP 12.4 Initialize and add the callback function for IPv4 events */
	

	/* STEP 10 - Populate cnx_params with the network configuration */
	

	/* STEP 11 - Call net_mgmt() to request the Wi-Fi connection */


	return 0;
}
```
