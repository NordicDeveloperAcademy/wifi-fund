## prj.conf
```kconfig
# Wi-Fi
CONFIG_WIFI=y
CONFIG_WIFI_NRF700X=y
CONFIG_WPA_SUPP=y
CONFIG_NET_L2_ETHERNET=y
CONFIG_NET_L2_WIFI_SHELL=y

# Wi-Fi Credentials
CONFIG_WIFI_CREDENTIALS=y

# Networking Management API
CONFIG_NET_CONNECTION_MANAGER=y

# Support for shell commands
CONFIG_SHELL=y
CONFIG_NET_L2_WIFI_SHELL=y
CONFIG_WIFI_CREDENTIALS_SHELL=y
CONFIG_SHELL_STACK_SIZE=4400

# Flash
CONFIG_FLASH=y
CONFIG_FLASH_PAGE_LAYOUT=y
CONFIG_FLASH_MAP=y
CONFIG_NVS=y
CONFIG_SETTINGS=y
CONFIG_SETTINGS_NVS=y

CONFIG_SPI_NOR=n

# Logging
CONFIG_LOG=y
CONFIG_NET_LOG=y
CONFIG_NET_SHELL=y
CONFIG_LOG_MODE_IMMEDIATE=y

# DK library
CONFIG_DK_LIBRARY=y

# System settings
#CONFIG_NEWLIB_LIBC=y
CONFIG_NEWLIB_LIBC_NANO=n

# Kernel options
CONFIG_TEST_RANDOM_GENERATOR=y

# Networking config
CONFIG_NETWORKING=y
CONFIG_NET_IPV4=y
CONFIG_NET_IPV6=n
CONFIG_NET_TCP=y
CONFIG_NET_UDP=y
CONFIG_NET_DHCPV4=y
CONFIG_NET_SOCKETS=y
CONFIG_NET_SOCKETS_POSIX_NAMES=y
CONFIG_NET_MAX_CONN=10
CONFIG_NET_MAX_CONTEXTS=20
CONFIG_NET_STATISTICS=y
CONFIG_NET_TCP_TIME_WAIT_DELAY=0

# Memory
CONFIG_MAIN_STACK_SIZE=4096

CONFIG_NET_TCP_WORKQ_STACK_SIZE=2048
CONFIG_NET_PKT_RX_COUNT=64
CONFIG_NET_PKT_TX_COUNT=64
CONFIG_NET_BUF_RX_COUNT=96
CONFIG_NET_BUF_TX_COUNT=96
CONFIG_NET_CONTEXT_NET_PKT_POOL=y
CONFIG_NET_BUF_POOL_USAGE=y

# IP address config
CONFIG_NET_CONFIG_SETTINGS=y
CONFIG_NET_CONFIG_INIT_TIMEOUT=0
CONFIG_NET_CONFIG_NEED_IPV4=y
CONFIG_NET_CONFIG_MY_IPV4_ADDR="192.0.2.1"

# DNS
#  STEP 1 - Enable necssary DNS configurations


# HTTP
# STEP 2 - Enable Zephyr's HTTP parser functionality
```

## boards/nrf7002dk_nrf5340_cpuapp_ns.conf
```kconfig
# UART1 is used for TF-M logging should be disabled
CONFIG_TFM_SECURE_UART=n
CONFIG_TFM_LOG_LEVEL_SILENCE=y

CONFIG_WIFI_CREDENTIALS_BACKEND_PSA=y
CONFIG_TFM_PROFILE_TYPE_MEDIUM=y
CONFIG_PM_PARTITION_SIZE_TFM_SRAM=0x18000
CONFIG_MBEDTLS_HEAP_SIZE=1638
```

## src/main.c
```c
/*
 * Copyright (c) 2019 Intel Corporation
 * Copyright (c) 2023 Nordic Semiconductor ASA
 *
 * SPDX-License-Identifier: Apache-2.0
 */

#include <errno.h>
#include <stddef.h>
#include <string.h>
#include <stdio.h>
#include <zephyr/kernel.h>
#include <zephyr/types.h>
#include <zephyr/logging/log.h>

#include <dk_buttons_and_leds.h>

#include <zephyr/net/wifi.h>
#include <zephyr/net/wifi_mgmt.h>
#include <zephyr/net/net_mgmt.h>
#include <net/wifi_mgmt_ext.h>
#include <net/wifi_credentials.h>
#include <zephyr/net/socket.h>
#include <zephyr/net/http/client.h>

#include <zephyr/net/conn_mgr_monitor.h>

/* STEP 3 - Include Zephyr's HTTP parser header file */


LOG_MODULE_REGISTER(Lesson5_Exercise3, LOG_LEVEL_INF);

/* STEP 4 - Define the port number for the server */


#define MAX_CLIENT_QUEUE		2
#define STACK_SIZE			4096
#define THREAD_PRIORITY			K_PRIO_COOP(CONFIG_NUM_COOP_PRIORITIES - 1)
#define EVENT_MASK (NET_EVENT_L4_CONNECTED | NET_EVENT_L4_DISCONNECTED)

/* STEP 5 - Define a struct to represent the structure of HTTP requests */


/* Forward declarations */
static void process_tcp4(void);

/* Keep track of the current LED states. 0 = LED OFF, 1 = LED ON.
 * Index 0 corresponds to LED1, index 1 to LED2.
 */
static uint8_t led_states[2];

/* STEP 6 - Define HTTP server response strings for demonstration */


/* STEP 7 - Set up threads for handling multiple incoming TCP connections simultaneously */


/* STEP 8 - Declare and initialize structs and variables used in network management */


/* STEP 11.1 - Define a variable to store the HTTP parser settings */


static struct net_mgmt_event_callback mgmt_cb;
static bool connected;
static K_SEM_DEFINE(run_app, 0, 1);

static void net_mgmt_event_handler(struct net_mgmt_event_callback *cb,
			  uint32_t mgmt_event, struct net_if *iface)
{
	if ((mgmt_event & EVENT_MASK) != mgmt_event) {
		return;
	}

	if (mgmt_event == NET_EVENT_L4_CONNECTED) {
		LOG_INF("Network connected");
		connected = true;
		k_sem_give(&run_app);

		return;
	}

	if (mgmt_event == NET_EVENT_L4_DISCONNECTED) {
		if (connected == false) {
			LOG_INF("Waiting for network to be connected");
		} else {
			LOG_INF("Network disconnected");
			connected = false;
		}

		k_sem_reset(&run_app);

		return;
	}
}

/* STEP 9 -  Define a function to update the LED state */


/* STEP 10 -   Define a function to handle HTTP requests */


/* STEP 11.2 - Define callbacks for the HTTP parser */


/* STEP 11.3 - Define function to initialize the callbacks */


/* STEP 12 -  Setup the HTTP server */


/* STEP 13 -  Setup the TCP client connection handler */


static int get_free_slot(int *accepted)
{
	int i;

	for (i = 0; i < MAX_CLIENT_QUEUE; i++) {
		if (accepted[i] < 0) {
			return i;
		}
	}

	return -1;
}

/* STEP 14 - Setup functions to handle incoming TCP connections */


/* STEP 15.1 - Define function to start listening on TCP socket */


int main(void)
{
	int err;

	parser_init();

	err = dk_leds_init();
	if (err) {
		LOG_ERR("Failed to initialize LEDs");
		return 0;
	}

	net_mgmt_init_event_callback(&mgmt_cb, net_mgmt_event_handler, EVENT_MASK);
	net_mgmt_add_event_callback(&mgmt_cb);

	conn_mgr_mon_resend_status();

	/* Wait for the connection. */
	k_sem_take(&run_app, K_FOREVER);

	/* STEP 15.2 - Call the start_listener function */
	

	(void)err;

	return 0;
}
```
