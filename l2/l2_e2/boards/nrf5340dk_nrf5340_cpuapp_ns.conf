## omar_less4_exer1/sample.yaml
```yaml
sample:
  description: MQTT over Wi-Fi sample
    application
  name: MQTT over Wi-Fi
tests:
  sample.nrf7002.provisioning:
    build_only: true
    integration_platforms:
      - nrf7002dk_nrf5340_cpuapp
    platform_allow: nrf7002dk_nrf5340_cpuapp
    tags: ci_build
```

## v2.6.0-v2.5.0/l3/l3_e2_sol/boards/nrf7002dk_nrf5340_cpuapp.conf
```kconfig
CONFIG_WIFI_CREDENTIALS_BACKEND_SETTINGS=y
CONFIG_FLASH=y
CONFIG_FLASH_PAGE_LAYOUT=y
CONFIG_FLASH_MAP=y
CONFIG_NVS=y
CONFIG_SETTINGS=y
CONFIG_SETTINGS_NVS=y

# STEP 1.3 Increase the heap memory pool size.
CONFIG_HEAP_MEM_POOL_SIZE=200000
```

## v2.6.0-v2.5.0/l6/l6_e2/boards/nrf7002dk_nrf5340_cpuapp_ns.conf
```kconfig
CONFIG_WIFI_CREDENTIALS_BACKEND_PSA=y
CONFIG_TFM_PROFILE_TYPE_MEDIUM=y
CONFIG_PM_PARTITION_SIZE_TFM_SRAM=0x18000
CONFIG_MBEDTLS_HEAP_SIZE=16384
```

## v3.0.0/l5/l5_e3_sol/Kconfig
```kconfig
#
# Copyright (c) 2025 Nordic Semiconductor ASA
#
# SPDX-License-Identifier: LicenseRef-Nordic-5-Clause
#

menu "Wi-Fi Fund Lesson 5 Exercise 3"

# STEP 4 - Define the Kconfig for the server port
config HTTP_SERVER_SAMPLE_PORT
    int "HTTP server port"
    default 80

endmenu

source "Kconfig.zephyr"
```
